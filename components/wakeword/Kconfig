## components/wakeword/Kconfig
```kconfig
menu "Wake-Word Service"
    config WAKEWORD_STACK_SIZE
        int "Wake-word task stack size"
        default 4096
    config WAKEWORD_DETECT_LOG
        bool "Print log when keyword detected"
        default y
endmenu
```

## sdkconfig.defaults
```kconfig
# Disable all esp_lcd panels (we don't use a display)
CONFIG_ESP_LCD=y
CONFIG_ESP_LCD_RGB_NONE=y
CONFIG_ESP_LCD_SKIP_COMPONENT=y

CONFIG_ESP_SR_ENABLE_WN9=y
CONFIG_ESP_SR_WN9_MODEL_NAME="wn9_nihaoxiaozhi_tts"
CONFIG_ESP_SR_MN1S_MODEL_NAME=""
CONFIG_ESP_SR_AFE_PITCH_SHIFT_DISABLE=y      
CONFIG_SR_ENABLE_AFE_V2=y                    
```
